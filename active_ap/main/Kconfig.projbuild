## passive/main/Kconfig.projbuild
```kconfig
menu "VeriCSI-ESP32 Config"

    config WIFI_CHANNEL
        int "WiFi Channel"
        default 6
        help
            Select the WiFi channel to listen to passively. In North America, valid channels are {1,2,3,...,10,11}.

    choice ESP32_CSI_TOOL_PASSIVE_FILTER
        prompt "Promiscuous frame filter (passive mode only)"
        default ESP32_CSI_TOOL_PASSIVE_FILTER_MGMT_DATA
        help
            Which 802.11 frame classes the promiscuous receiver should
            deliver to the CSI driver. Frames not in the selected mask
            are dropped at the radio layer and NEVER reach the CSI rx
            callback - lower the filter only if you specifically want
            to focus on a sub-class.

            * MGMT_DATA (default): beacons + probes + data frames.
              Beacons give a stable ~10 fps baseline regardless of
              traffic; data frames give sample-rate uplift when STAs
              are actively communicating. Best general-purpose choice.

            * DATA only: matches Hernandez 2020 v1. Use when you have
              a controlled data source (paired ESP32 / continuous ping)
              and want zero beacon noise. With no controlled source the
              capture will be sparse / bursty.

            * MGMT_CTRL_DATA: include ACK / RTS / CTS in addition.
              Highest CSI yield; ACKs add ~doubled rate when STAs are
              active. Useful for traffic analysis; CSI on short ACK
              frames is noisier than on data frames.

            * ALL: everything including FCSFAIL (frames that failed
              CRC). Diagnostic only - FCSFAIL frames have unreliable
              CSI.

        config ESP32_CSI_TOOL_PASSIVE_FILTER_MGMT_DATA
            bool "MGMT + DATA (default; beacon baseline + data frames)"
        config ESP32_CSI_TOOL_PASSIVE_FILTER_DATA_ONLY
            bool "DATA only (Hernandez 2020 v1 default; needs traffic source)"
        config ESP32_CSI_TOOL_PASSIVE_FILTER_MGMT_CTRL_DATA
            bool "MGMT + CTRL + DATA (max yield; includes ACK / RTS / CTS)"
        config ESP32_CSI_TOOL_PASSIVE_FILTER_ALL
            bool "ALL including FCSFAIL (diagnostic only; noisy CSI)"
    endchoice

    config SHOULD_COLLECT_CSI
        bool "Should this ESP32 collect and print CSI data?"
        default y
        help
            Allowing only a single ESP32 to collect CSI will likely increase the sampling frequency of your experiments.

    config ESP32_CSI_TOOL_DUMP_ACK_FRAMES
        depends on SHOULD_COLLECT_CSI
        bool "Capture CSI from ACK frames too (sets dump_ack_en=1)"
        default n
        help
            Enables dump_ack_en. In passive (promiscuous) mode this lets
            the chip deliver CSI for ACK frames in addition to data and
            management. The v2 CSV `frame_type` column  lets
            downstream tooling separate ACK rows. Useful for monitoring
            two-way conversations between other STAs in the air. Default n.

    config SHOULD_COLLECT_ONLY_LLTF
        depends on SHOULD_COLLECT_CSI
        bool "(Advanced users only) Should we only collect LLTF?"
        default y
        help
            Each CSI frame can contain CSI either calculated through
            (1) legacy long training field (LLTF),
            (2) high throughput LTF (HT-LTF) and/or
            (3) space-time block code HT-LTF (STBC-HT-LTF).
            However, not all CSI frames have HT-LTF or STBC-HT-LTF while all CSI frame have LLTF.
            For beginners collecting only LLTF is the best option while advanced users can handle issues such as
            (1) HT-LTF or STBC-HT-LTF being missing, and
            (2) possible decreases in sampling rate due to serial connection saturation.
            On ESP32-C61, force-LLTF is also the workaround for upstream issue espressif/esp-idf#18118
            (CSI broken for 802.11g packets).
            [Advanced Users]: I cannot always help with these advanced issues,
            but if you have ideas on improvements to these issues please share!

    config SEND_CSI_TO_SERIAL
        depends on SHOULD_COLLECT_CSI
        bool "Send CSI data to Serial"
        default y
        help
            Sending data through serial (to a computer) can take time and buffer space.
            If you are storing to an SD card, it may be useful to deselect this option.

    config SEND_CSI_TO_SD
        depends on SHOULD_COLLECT_CSI
        bool "Send CSI data to SD"
        default n
        help
            Sending data to an SD card can take time and buffer space.
            If your ESP32 does not have an SD card, there is no reason to use this feature.
            If you do though, the program will be recognize this and not attempt writing to the SD card.

    #
    # (passive mode does not transmit, so the broadcast menu
    # is not exposed here).
    #
    config ESP32_CSI_TOOL_2G_BANDWIDTH_HT40
        bool "2.4 GHz radio bandwidth HT40 (else HT20)"
        default n
        help
            Sets the 2.4 GHz radio bandwidth to 40 MHz. On HE-era chips
            (C5 / C6 / C61) this populates wifi_bandwidths_t.ghz_2g with
            WIFI_BW40; on pre-HE chips (ESP32 / S2 / S3 / C3) it calls the
            classic esp_wifi_set_bandwidth(iface, WIFI_BW_HT40). Applies to
            STA and AP interfaces; the passive app runs in WIFI_MODE_NULL
            with no interface and keeps the driver default bandwidth.
            HT40 doubles channel occupancy: enable it on BOTH ends of the
            link, and expect longer CSI records (HT-LTF over 128
            subcarriers).

    menu "Wi-Fi 6 HE-LTF acquisition (C5 / C6 / C61 only)"
        depends on SHOULD_COLLECT_CSI

        config ESP32_CSI_TOOL_ENABLE_11AX
            bool "Enable 802.11ax (Wi-Fi 6) at the MAC protocol layer"
            depends on SOC_WIFI_HE_SUPPORT
            default y
            help
                Required for the radio to recognise HE preambles in
                promiscuous mode. Disable for an 11n-only ablation. See
                _components/wifi_band_component.h.

        config ESP32_CSI_TOOL_ACQUIRE_LEGACY
            int "Acquire legacy L-LTF CSI (1=yes, 0=no)"
            depends on SOC_WIFI_HE_SUPPORT
            range 0 1
            default 1
            help
                MAC v2/v3 acquire_csi_legacy flag. Set 0 to route HT frames
                exclusively through the HT acquire slots: on a 40 MHz
                sniffing ESP32-C6 the legacy slot delivers near-zero garbage
                for HT20 frames (observed 2026-08-08) while the HT slots
                deliver healthy values.

        config ESP32_CSI_TOOL_ACQUIRE_HE_SU
            bool "Acquire HE-LTF in single-user (SU) mode"
            depends on SOC_WIFI_HE_SUPPORT
            default y
            help
                Sets acquire_csi_su=1. Default y on HE-capable chips
                (C5 / C6 / C61) so that promiscuous-mode sniffing of a
                modern Wi-Fi 6 network actually captures HE-LTF CSI from
                the dominant SU traffic class. Disable for an 11n-only
                ablation.

        config ESP32_CSI_TOOL_ACQUIRE_HE_MU
            bool "Acquire HE-LTF in multi-user (MU) mode"
            depends on SOC_WIFI_HE_SUPPORT
            default n
            help
                Sets acquire_csi_mu=1. MU-MIMO frames are always
                beamformed and rare in typical home / lab traffic. Enable
                only for OFDMA / MU-MIMO research; otherwise MU CSI is
                a contamination source for sensing tasks.

        config ESP32_CSI_TOOL_ACQUIRE_HT20
            int "Acquire CSI from HT20 (20 MHz) frames (1=yes, 0=no)"
            depends on SOC_WIFI_HE_SUPPORT
            range 0 1
            default 1
            help
                Sets acquire_csi_ht20 in wifi_csi_acquire_config_t. Default 1,
                since HT20 is the dominant format on 2.4 GHz networks and a
                receiver with it off is blind to them. Set 0 to isolate a
                single acquire slot, which is the sweep experiment E25 runs.

                An int and not a bool: the C fallback for an undefined macro
                is 1, so a bool left unset would read as enabled.

        config ESP32_CSI_TOOL_ACQUIRE_HT40
            bool "Acquire CSI from HT40 (40 MHz) frames"
            depends on SOC_WIFI_HE_SUPPORT
            default n
            help
                Sets acquire_csi_ht40=1 in wifi_csi_acquire_config_t so the
                MAC v2 / v3 acquire path delivers CSI for 40 MHz HT frames.
                Requires the radio bandwidth to be 40 MHz (see the 2.4 GHz
                bandwidth option, or the ESP32-C5 5 GHz bandwidth option)
                and an HT40-capable peer. The chip-aware decoder tags these
                records as the HT40 layout.

        config ESP32_CSI_TOOL_ACQUIRE_VHT
            bool "Acquire CSI from VHT (802.11ac) frames"
            depends on SOC_WIFI_HE_SUPPORT && IDF_TARGET_ESP32C5
            default n
            help
                Sets acquire_csi_vht=1 in wifi_csi_acquire_config_t (MAC v3
                only; the ESP32-C5 is the only family member with a 5 GHz
                radio, and 802.11ac exists only at 5 GHz). VHT on this chip
                is 20 MHz-only, so this option conflicts with the 5 GHz HT40
                bandwidth option the same way 11ac in the protocol mask
                does: use VHT20 sessions for ac capture.

        config ESP32_CSI_TOOL_HE_STBC_MODE
            int "HE-STBC mode (0/1/2)"
            depends on SOC_WIFI_HE_SUPPORT
            range 0 2
            default 2

        config ESP32_CSI_TOOL_ACQUIRE_DCM
            bool "Acquire HE-LTF from DCM (Dual Carrier Modulation) PPDUs"
            depends on SOC_WIFI_HE_SUPPORT
            default n
            help
                Sets acquire_csi_dcm=1. DCM is rarely used in real Wi-Fi 6
                deployments; default n.

        config ESP32_CSI_TOOL_ACQUIRE_BEAMFORMED
            bool "Acquire CSI from beamformed packets too"
            depends on SOC_WIFI_HE_SUPPORT
            default n
            help
                Sets acquire_csi_beamformed=1. For passive sniffing of a
                real Wi-Fi 6 network, enable this so HE-LTF beamformed
                downlink unicast frames (the majority of 11ax air time)
                are captured. The captured CSI is H * V (post-steering),
                not H; treat the data carefully for fine-grained sensing.
                See docs/known_issues.md for details.

        config ESP32_CSI_TOOL_VAL_SCALE
            int "val_scale_cfg"
            default 0
    endmenu

    menu "Output sinks"
        depends on SHOULD_COLLECT_CSI

        config ESP32_CSI_TOOL_SINK_USB_JTAG
            bool "USB-Serial-JTAG sink (C3 / S3 / C5 / C6 / C61)"
            default n

        config ESP32_CSI_TOOL_SINK_USB_CDC
            bool "TinyUSB CDC sink (ESP32-S2; not hardware-verified)"
            default n

        config ESP32_CSI_TOOL_CDC_WAIT_HOST_S
            int "Seconds to wait for the USB-CDC host before CSI starts"
            depends on ESP32_CSI_TOOL_SINK_USB_CDC
            default 30
            range 0 600
            help
                The TinyUSB port opens only after the host enumerates the
                device, so the header and the first rows written before the
                host attaches never reach the capture file. With a non-zero
                value csi_init waits until the host asserts DTR, or until this
                many seconds pass, before it enables CSI. A capture then holds
                its boot session, which the whole-session verdict needs.
                0 starts CSI at once.

        config ESP32_CSI_TOOL_SINK_UDP
            bool "UDP sink"
            default n
            help
                Note: passive mode does not associate with any AP, so UDP requires
                an external coordinator (or another role temporarily switching
                modes) to set up the network. Most users prefer UART or
                USB-Serial-JTAG for passive captures.

        config ESP32_CSI_TOOL_UDP_HOST
            string "UDP destination host (IPv4)"
            depends on ESP32_CSI_TOOL_SINK_UDP
            default "192.168.4.2"

        config ESP32_CSI_TOOL_UDP_PORT
            int "UDP destination port"
            depends on ESP32_CSI_TOOL_SINK_UDP
            range 1 65535
            default 5005
    endmenu

    menu "PSRAM ring buffer (ESP32-S3 with Octal PSRAM)"
        depends on SHOULD_COLLECT_CSI && SPIRAM

        config ESP32_CSI_TOOL_PSRAM_RING_BUFFER
            bool "Allocate the CSI queue in PSRAM (heap_caps_malloc MALLOC_CAP_SPIRAM)"
            default n
            help
                Allocate the CSI consumer queue from PSRAM. For passive
                long-recording sniffer setups on ESP32-S3 with Octal PSRAM.

        config ESP32_CSI_TOOL_PSRAM_QUEUE_DEPTH
            int "PSRAM-backed queue depth (item count)"
            depends on ESP32_CSI_TOOL_PSRAM_RING_BUFFER
            range 256 65536
            default 4096
            help
                ~500 byte per item. 4096 items = ~2 MB ring (40 s at 100 Hz).
    endmenu

    menu "Diagnostics and consumer scheduling"
        depends on SHOULD_COLLECT_CSI

        config ESP32_CSI_TOOL_DIAG_FRAME_PERIOD_S
            int "Diagnostic frame period (seconds; 0 = disabled)"
            range 0 3600
            default 10

        config ESP32_CSI_TOOL_RECORD_DIE_TEMP
            bool "Sample the on-die temperature into each record"
            default y
            help
                Populates the die_temp_c10 column with the on-die temperature
                in tenths of a degree Celsius, sampled on the diagnostic
                cadence rather than per record because the sensor is slow.

                This exists because a device clock's rate moves with die
                temperature: self-heating under Wi-Fi load shifts one board by
                4 to 8 ppm within minutes, so a rate calibration only transfers
                at thermal equilibrium. Carrying the temperature with the
                record turns that from a caveat into a covariate.

                Turning it off does NOT remove the column. The schema is a
                fixed superset across every SoC and every build, so the column
                is always emitted and reports -1000 when the part has no sensor
                (the original ESP32) or when this option is off. A reader can
                then separate "not measured" from a measurement, which is what
                the NULL semantics are for.

        config ESP32_CSI_TOOL_RX_GAIN_CTRL
            bool "Read the per-record receive gain (schema v2.2)"
            default n
            help
                Links the vendor component esp_csi_gain_ctrl and fills the
                agc_gain and fft_gain columns from each record's
                receive-control structure. With this off both columns read -1,
                which is how every capture in this repository before
                2026-08-18 was taken.

                Automatic gain control is a documented source of cross-device
                CSI disagreement, and a capture that does not record the gain
                cannot be inverted to a gain-independent quantity afterwards.
                Recording it per record is what makes that inversion possible.

                The component ships as a precompiled static library per IDF
                version and target. It is Apache-licensed but not
                source-available, so a capture taken with this option depends
                on a binary this project cannot rebuild. Leave it off unless
                the gain is the subject of the measurement.

                Requires the dependency in main/idf_component.yml:
                idf.py add-dependency "espressif/esp_csi_gain_ctrl^0.1.5"

        config ESP32_CSI_TOOL_RX_GAIN_FORCE
            bool "Record a forced receive-gain value"
            default n
            help
                States in every record that this build locks the receive gain,
                and to what value, through the gain_force_val column.

                ESP-IDF exposes no public API to read or set the automatic gain
                control, so this option does not itself lock anything: it
                declares a lock applied by other means. With it off the column
                reports -1, which is the honest description of every capture in
                this repository, all of which ran with the gain free.

                The distinction matters because automatic gain control is a
                documented source of cross-device CSI disagreement, and a
                consumer that cannot tell a free-gain capture from a locked one
                cannot correct for it.

        config ESP32_CSI_TOOL_RX_GAIN_FORCE_VALUE
            int "Forced receive-gain value"
            depends on ESP32_CSI_TOOL_RX_GAIN_FORCE
            range 0 255
            default 0
            help
                The value written to the gain_force_val column. Meaningful only
                if the gain is actually locked to it by other means.

        config ESP32_CSI_TOOL_RX_GAIN_FORCE_FFT
            int "Forced FFT-gain value"
            depends on ESP32_CSI_TOOL_RX_GAIN_FORCE
            range -128 127
            default 0
            help
                The FFT-gain half of the lock. esp_csi_gain_ctrl takes the
                receive gain as an AGC value and an FFT value, so locking one
                without the other locks nothing.

                Pick both from the distribution a free-gain session records in
                the agc_gain and fft_gain columns, not by guessing. Picking the
                value that makes a later result look better cannot be told
                apart from picking one honestly, which is why the order is
                fixed: measure free, take the median, then lock.


        config ESP32_CSI_TOOL_DIAG_CPU_LOAD
            bool "Report CPU load in the diagnostic frame"
            default n
            select FREERTOS_USE_TRACE_FACILITY
            select FREERTOS_GENERATE_RUN_TIME_STATS
            help
                Appends cpu_load_permille to each `# DIAG` line: the fraction
                of the last diagnostic interval the CPU spent outside the idle
                task, in tenths of a percent, or -1 when unavailable.

                This is the term the vendor current figures leave out. A
                datasheet quotes receive current with the CPU idle and the
                peripherals disabled, which is not the condition a capture runs
                in, so that figure bounds a capture from below and says nothing
                about how far below. Measured here, an ESP32-S2 delivering
                111 frames/s sits at 96 percent.

                It is NOT energy. These parts expose no current or power
                sensor, so nothing on the device can measure consumption; an
                energy figure needs an external meter.

                Off by default because it selects the FreeRTOS run-time stats,
                which add per-task accounting to every context switch. That
                cost lands on the capture path, so enable it when the number is
                wanted and leave it off for throughput runs.

                Cross-SoC comparison: the load rises with delivery rate (an
                ESP32-S2 reads 89 percent at 97 frames/s and 95 percent at
                110), so quote it at one fixed operating point. This project
                uses a 100 Hz access-point sounding rate as that reference.

        config ESP32_CSI_TOOL_CONSUMER_CORE
            int "CSI consumer task pinned core (0 or 1)"
            depends on !FREERTOS_UNICORE
            range 0 1
            default 0

        config ESP32_CSI_TOOL_CONSUMER_YIELD_EVERY
            int "CSI consumer cooperative yield interval (frames; 0 = never)"
            range 0 1024
            default 32
    endmenu

    menu "Binary frame sink"
        depends on SHOULD_COLLECT_CSI

        config ESP32_CSI_TOOL_SINK_BINARY
            bool "Emit binary frames in addition to CSV"
            default n
    endmenu

    config ESP32_CSI_TOOL_UDP_BATCH_LINES
        int "UDP datagram batch size (CSV lines per datagram)"
        depends on ESP32_CSI_TOOL_SINK_UDP
        range 1 32
        default 1

    menu "ESP32-C5 Wi-Fi band selection"
        depends on IDF_TARGET_ESP32C5

        choice ESP32_CSI_TOOL_C5_BAND_MODE
            prompt "ESP32-C5 Wi-Fi band mode"
            default ESP32_CSI_TOOL_C5_BAND_MODE_2G_ONLY
            help
                WARNING: 5 GHz CSI is subject to upstream issue
                espressif/esp-idf#18493 (static IQ buffer); empirically
                verify CSI varies before relying on the data. Note that
                passive promiscuous mode in 5 GHz may need the radio in
                STA mode rather than NULL; switch via menuconfig if needed.

            config ESP32_CSI_TOOL_C5_BAND_MODE_2G_ONLY
                bool "2.4 GHz only (default; #18493 workaround)"
            config ESP32_CSI_TOOL_C5_BAND_MODE_5G_ONLY
                bool "5 GHz only (experimental)"
            config ESP32_CSI_TOOL_C5_BAND_MODE_AUTO
                bool "Auto / dual-band (experimental)"
        endchoice

        config ESP32_CSI_TOOL_C5_5G_CHANNEL
            int "ESP32-C5 5 GHz channel"
            depends on !ESP32_CSI_TOOL_C5_BAND_MODE_2G_ONLY
            range 36 165
            default 40

        config ESP32_CSI_TOOL_C5_5G_BANDWIDTH_HT40
            bool "ESP32-C5 5 GHz bandwidth: HT40 (else HT20)"
            depends on !ESP32_CSI_TOOL_C5_BAND_MODE_2G_ONLY
            default n
    endmenu

    #
    # Hidden VERICSI-prefix mirrors of the legacy Kconfig names.
    #
    config ESP32_CSI_TOOL_COLLECT_CSI
        bool
        default SHOULD_COLLECT_CSI

    config ESP32_CSI_TOOL_FORCE_LLTF
        bool
        default SHOULD_COLLECT_ONLY_LLTF

    config ESP32_CSI_TOOL_SINK_UART
        bool
        default SEND_CSI_TO_SERIAL

    config ESP32_CSI_TOOL_SINK_SD
        bool
        default SEND_CSI_TO_SD

    menu "Acquisition contract (2026-09-15)"

        config ESP32_CSI_TOOL_CAPTURE_DURATION_S
            int "Finite capture duration in seconds (0 = run forever)"
            default 0
            help
                When set above 0, the consumer task stops admitting CSI
                callbacks after this many seconds, drains its queue, emits a
                terminal "# DIAG_END" frame whose drained marker certifies
                the tail, flushes every sink, and parks itself. Used by the
                accounting-validation bench for windows with a provable end.

        config ESP32_CSI_TOOL_FAULT_INJECT
            bool "Enable deterministic fault injection (TEST BUILDS ONLY)"
            default n
            help
                Gates the FI_* counters below. Never enable in a capture
                whose data is meant for analysis: the injected events are
                synthetic and exist only to validate that the accounting
                classifies each failure mode correctly.

        config ESP32_CSI_TOOL_FI_REJECT_EVERY_N
            int "Reject every Nth callback before enqueue (0 = off)"
            depends on ESP32_CSI_TOOL_FAULT_INJECT
            default 0

        config ESP32_CSI_TOOL_FI_QUEUE_DROP_EVERY_N
            int "Count every Nth frame as a queue drop without enqueue (0 = off)"
            depends on ESP32_CSI_TOOL_FAULT_INJECT
            default 0

        config ESP32_CSI_TOOL_FI_LAYOUT_DROP_EVERY_N
            int "Classify every Nth dequeued frame as a layout drop (0 = off)"
            depends on ESP32_CSI_TOOL_FAULT_INJECT
            default 0

        config ESP32_CSI_TOOL_FI_SINK_FAIL_EVERY_N
            int "Drop every Nth formatted row before the sink, counted (0 = off)"
            depends on ESP32_CSI_TOOL_FAULT_INJECT
            default 0

        config ESP32_CSI_TOOL_FI_DUP_EVERY_N
            int "Enqueue every Nth frame twice, uncounted (0 = off)"
            depends on ESP32_CSI_TOOL_FAULT_INJECT
            default 0
            help
                The duplicate is deliberately not counted anywhere: it is
                the anomaly the sequence-level audit must catch despite the
                count cancellation of one missing plus one duplicated row.

    endmenu

endmenu
```
